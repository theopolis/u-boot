## board/aspeed/ast2400/Kconfig
```kconfig
if TARGET_AST2400

config SYS_BOARD
  default "ast2400"

config SYS_VENDOR
  default "aspeed"

config SYS_CONFIG_NAME
  default "wedge" if TARGET_WEDGE
  default "wedge100" if TARGET_WEDGE100
  default "fbyosemite" if TARGET_FBYOSEMITE

endif
```

## board/bf-obmc/Kconfig
```kconfig
if TARGET_BFMAVERICKS
config SYS_CPU
  default "arm926ejs"
config SYS_BOARD
  default "ast-g4"
config SYS_VENDOR
  default "aspeed"
config SYS_SOC
  default "aspeed"
config SYS_CONFIG_NAME
  default "bfmavericks"
endif
```

## board/facebook/Kconfig
```kconfig
if TARGET_FBYOSEMITE

config SYS_CPU
	default "arm926ejs"

config SYS_BOARD
	default "ast2400"

config SYS_VENDOR
	default "aspeed"

config SYS_SOC
	default "aspeed"

config SYS_CONFIG_NAME
	default "fbyosemite"

endif

if TARGET_FBLIGHTNING

config SYS_CPU
        default "arm926ejs"

config SYS_BOARD
        default "ast2400"

config SYS_VENDOR
        default "aspeed"

config SYS_SOC
        default "aspeed"

config SYS_CONFIG_NAME
        default "fblightning"

endif

if TARGET_FBWEDGE

config SYS_CPU
  default "arm926ejs"

config SYS_BOARD
  default "ast2400"

config SYS_VENDOR
  default "aspeed"

config SYS_SOC
  default "aspeed"

config SYS_CONFIG_NAME
  default "fbwedge"

endif

if TARGET_FBWEDGE100

config SYS_CPU
  default "arm926ejs"

config SYS_BOARD
  default "ast2400"

config SYS_VENDOR
  default "aspeed"

config SYS_SOC
  default "aspeed"

config SYS_CONFIG_NAME
  default "fbwedge100"

endif
```

## configs/fbyosemite_defconfig
```kconfig
CONFIG_ARM=y
CONFIG_TARGET_FBYOSEMITE=y
CONFIG_SYS_NS16550=y
# CONFIG_CMD_IMLS is not set
# CONFIG_CMD_FLASH is not set
# CONFIG_CMD_FPGA is not set
# CONFIG_CMD_SETEXPR is not set
CONFIG_CMD_IMI=y
CONFIG_OF_LIBFDT=y
CONFIG_FIT=y
CONFIG_FIT_VERBOSE=y
CONFIG_FIT_SIGNATURE=y
CONFIG_DM=y

# Require an external FDT for the keystore.
CONFIG_OF_CONTROL=y
CONFIG_OF_EMBED=y

# Enable an SPL build.
CONFIG_SPL=y
CONFIG_SPL_DM=y
CONFIG_SPL_LOAD_FIT=y
CONFIG_SPL_FIT=y
CONFIG_SPL_OF_CONTROL=y
CONFIG_SPL_OF_LIBFDT=y
CONFIG_SPL_FIT_SIGNATURE=y

CONFIG_BOOTDELAY=3
```
